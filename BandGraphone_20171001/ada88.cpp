/*

*/
#include <Wire.h>
#include "ada88.h"


//---------------------------------------------------------
//		<< ADA88 >>
//---------------------------------------------------------
#define		ADA88_I2C_ADRS		0x70

void write_i2cDevice( unsigned char i2c, unsigned char* data, int cnt )
{
  int i;

  Wire.beginTransmission(i2c);
  for ( i=0; i<cnt; i++ ){
    Wire.write(*(data+i));
  }
  Wire.endTransmission();
}
//---------------------------------------------------------
//		Initialize ADA88 LED Matrix
//---------------------------------------------------------
void ada88_init( void )
{
	Wire.begin();

	unsigned char i2cBuf[2] = {0,0};
	i2cBuf[0] = 0x21;
	write_i2cDevice( ADA88_I2C_ADRS, i2cBuf, 2 );

	i2cBuf[0] = 0x81;
	write_i2cDevice( ADA88_I2C_ADRS, i2cBuf, 2 );

	i2cBuf[0] = 0xef;
	write_i2cDevice( ADA88_I2C_ADRS, i2cBuf, 2 );

	ada88_write(0);
}
//---------------------------------------------------------
//	write Character to Ada LED-matrix
//---------------------------------------------------------
void ada88_write( int letter )
{
	int	i;
	unsigned char i2cBufx[17];
	const unsigned char letters[21][8] = {
		{0x00,0x00,0x00,0x00,0x00,0x00,0x00,0x00},	//	0:nothing
		{0x02,0x05,0x88,0x88,0x8f,0x88,0x88,0x88},	//	1:A
		{0x87,0x88,0x88,0x87,0x88,0x88,0x88,0x87},	//	2:B
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		{0x55,0xaa,0x55,0xaa,0x55,0xaa,0x55,0xaa}	//	20:
	};

	i2cBufx[0] = 0;
	for ( i=0; i<8; i++ ){
		i2cBufx[i*2+1] = letters[letter][i];
		i2cBufx[i*2+2] = 0;
	}
	write_i2cDevice( ADA88_I2C_ADRS, i2cBufx, 17 );
}
//---------------------------------------------------------
void ada88_writeNumber( int num )	//	num 1999 .. -1999
{
	int i;
	unsigned char i2cBufx[17];
	unsigned char ledPtn[8] = {0};
	const unsigned char numletter[10][5] = {
		{ 0x07, 0x05, 0x05, 0x05, 0x07 },
		{ 0x04, 0x04, 0x04, 0x04, 0x04 },
		{ 0x07, 0x04, 0x07, 0x01, 0x07 },
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		{ 0x07, 0x05, 0x07, 0x04, 0x07 }
	};
	const unsigned char graph[10][2] = {
		{ 0x00, 0x00 },
		{ 0x00, 0x40 },
		{ 0x40, 0x60 },
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		{ 0xff, 0xff }
	};	

	if ( num > 1999 ){ num = 1999; }
	else if ( num < -1999 ){ num = -1999;}
	
	//	+/-, over 1000 or not
	if ( num/1000 ){ ledPtn[5] |= 0x80; }
	if ( num<0 ){
		ledPtn[2] |= 0x80;
		num = -num;
	}

	int num3digits = num%1000;
	int hundred = num3digits/100;
	int num2degits = num3digits%100;
	int deci = num2degits/10;
	int z2n = num2degits%10;

	for ( i=0; i<5; i++ ){
		ledPtn[i] |= numletter[hundred][i];
	}
	for ( i=0; i<5; i++ ){
		ledPtn[i] |= (numletter[deci][i]<<4);
	}
	for ( i=0; i<2; i++ ){
		ledPtn[i+6] = graph[z2n][i];
	}

	i2cBufx[0] = 0;
	for ( i=0; i<8; i++ ){
		i2cBufx[i*2+1] = ledPtn[i];
		i2cBufx[i*2+2] = 0;
	}
	write_i2cDevice( ADA88_I2C_ADRS, i2cBufx, 17 );
}
